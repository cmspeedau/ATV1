## Config.in
```kconfig
menu "ATV1 board support"

source "$BR2_EXTERNAL_ATV1_PATH/package/crystalhd/Config.in"
source "$BR2_EXTERNAL_ATV1_PATH/package/atv1-client/Config.in"

endmenu
```

## package/atv1-client/Config.in
```kconfig
config BR2_PACKAGE_ATV1_CLIENT
	bool "atv1-client (prebuilt Rust appliance client)"
	help
	  The Rust appliance control-surface binary (ARCHITECTURE
	  doc §1-§4): full-screen update flow, coordinator agent,
	  Kodi handoff adapter. Rust-only application code is the
	  project convention; Buildroot 2017.08-era has no Rust
	  toolchain, so the binary is cross-built against this
	  system's SDK out-of-era (tools/build-client.sh) and is
	  installed from the convention path:

	    $(BR2_EXTERNAL_ATV1_PATH)/client/atv1-client

  post-build.sh installs it there when this option is enabled.
  Startup model (headless agent vs tty1 kiosk replacing
  startkodi.sh) is an open ARCHITECTURE decision (§8) — until
  it is made, startkodi.sh keeps the kiosk and the client runs
  as a managed service only.
```

## package/crystalhd/Config.in
```kconfig
config BR2_PACKAGE_CRYSTALHD
	bool "crystalhd"
	depends on BR2_i386 || BR2_x86_64
	depends on BR2_TOOLCHAIN_USES_GLIBC
	select BR2_PACKAGE_LINUX_HEADERS
	help
	  Userspace library and utilities for the Broadcom BCM70012
	  CrystalHD hardware H.264/MPEG-2 decoder: a mini-PCIe add-on
	  card (the famous A1218 mod), NOT onboard hardware, and not
	  installed in this project's box — this package is dormant.
	  Kernel driver reality (verified against the kernel repos):
	  in-tree through Linux 3.16.x (final stable 3.16.85 still has
	  it), removed in 3.17; newer kernels only via crystalhd-arch's
	  maintained dkms port. Card path plan: board/atv1/linux.fragment.

	  https://github.com/crystalhd-arch/libcrystalhd

comment "crystalhd needs an x86 glibc toolchain"
	depends on !(BR2_i386 || BR2_x86_64) || !BR2_TOOLCHAIN_USES_GLIBC
```
